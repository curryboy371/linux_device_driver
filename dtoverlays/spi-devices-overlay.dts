/dts-v1/;
/plugin/;

&spi0 {
    #address-cells = <1>;
    #size-cells = <0>;
    
    status = "okay";

    vs1003@0 {
        compatible = "vs1003", "codec";
        reg = <0>;  // SPI0_CS0 사용
        spi-mode = <0>;
        spi-max-frequency = <4000000>;

        xdcs-gpios = <&gpio 25 1>;  // XDCS (GPIO 25 active low)
        dreq-gpios = <&gpio 24 0>; // DREQ (GPIO24, active-high)
        xrst-gpios = <&gpio 23 0>;   // XRST 핀 (GPIO23, active-high)
    };
};
