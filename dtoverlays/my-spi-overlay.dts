/dts-v1/;
/plugin/;
/{
    compatible = "brcm,bcm2711";

    fragment@0 {
        target-path = "/soc";
        __overlay__ {
            myspi: myspi {
                compatible = "chan,my-spi", "simple-bus";
                status = "okay";

                /* SPI 버스 관례 */
                #address-cells = <1>;
                #size-cells = <0>;

                myspi-sclk-gpios = <&gpio 5 0>;
                myspi-mosi-gpios = <&gpio 6 0>;
                myspi-miso-gpios = <&gpio 13 0>;
            };
        };
    };
};
